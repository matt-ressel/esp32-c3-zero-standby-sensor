## main/Kconfig.projbuild
```kconfig
menu "ESP32C3 Zero Standby Sensor Configuration"

	config GATEWAY_MAC
		string "Gateway MAC address"
		default "FF:FF:FF:FF:FF:FF"
		help
			The MAC address of the gateway device. This should be set to the
			MAC address of the device that will receive the ESP-NOW messages.

	config ESPNOW_PMK
			string "ESPNOW primary master key"
			default "pmk1234567890123"
			help
					ESPNOW primary master for the example to use. The length of ESPNOW primary master must be 16 bytes.

	config ESPNOW_LMK
			string "ESPNOW local master key"
			default "lmk1234567890123"
			help
					ESPNOW local master for the example to use. The length of ESPNOW local master must be 16 bytes.
					The local master key is used to encrypt the data sent by the ESP32-C6.

	config ESPNOW_CHANNEL
			int "ESPNOW Channel"
			default 1
			range 0 14
			help
					The channel on which sending and receiving ESPNOW data.

	config I2C_MASTER_SDA_PIN
		int "I2C SDA Pin"
		default 18
		help
			GPIO pin number for I2C SDA line.

	config I2C_MASTER_SCL_PIN
		int "I2C SCL Pin"
		default 19
		help
			GPIO pin number for I2C SCL line.				

	config I2C_MASTER_FREQUENCY
		int "I2C Master Frequency"
		default 100000
		help
			Frequency for I2C master clock.

				
            
endmenu
```
